## k230_linux_sdk/buildroot-overlay/package/aic8800_sdio/Config.in
```kconfig
config BR2_PACKAGE_AIC8800_SDIO
    bool "AIC8800 SDIO"
    select BR2_PACKAGE_BLUEZ_INC
    help
        AIC8800 SDIO
```

## k230_linux_sdk/buildroot-overlay/package/aic8800_sdio/Kconfig
```kconfig
config AIC_WLAN_SUPPORT_SDIO
	bool "AIC wireless Support"
	default n
	help
	  This is support for aic wireless chip.

if AIC_WLAN_SUPPORT_SDIO
source "drivers/net/wireless/aic8800/aic8800_fdrv/Kconfig"
source "drivers/net/wireless/aic8800/aic_load_fw/Kconfig"
endif
```
